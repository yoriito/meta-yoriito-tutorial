## conf/layer.conf
```bitbake
# We have a conf and classes directory, add to BBPATH
BBPATH .= ":${LAYERDIR}"

# We have recipes-* directories, add to BBFILES
BBFILES += "${LAYERDIR}/recipes-*/*/*.bb \
            ${LAYERDIR}/recipes-*/*/*.bbappend"

BBFILE_COLLECTIONS += "yoriito-tutorial-layer"
BBFILE_PATTERN_yoriito-tutorial-layer = "^${LAYERDIR}/"
BBFILE_PRIORITY_yoriito-tutorial-layer = "16"

LAYERDEPENDS_yoriito-tutorial-layer = " \
  core openembedded-layer yoriito-layer flutter-layer \
"
LAYERSERIES_COMPAT_yoriito-tutorial-layer = "scarthgap"

# dynamic-layers
BBFILES_DYNAMIC += " \
  raspberrypi:${LAYERDIR}/dynamic-layers/raspberrypi/recipes-*/*/*.bb \
  raspberrypi:${LAYERDIR}/dynamic-layers/raspberrypi/recipes-*/*/*.bbappend \
"
```
